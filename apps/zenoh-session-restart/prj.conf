## CMakeLists.txt
```
# SPDX-License-Identifier: Apache-2.0


include(CMakePrintHelpers)

cmake_minimum_required(VERSION 3.20.0)
find_package(Zephyr REQUIRED HINTS $ENV{ZEPHYR_BASE})

project(zenoh_session_restart)

cmake_print_variables(CMAKE_VERBOSE_MAKEFILE)

# TODO Make the library configurable and should be moved at the top level CMakeLists.txt idealy
if(CONFIG_ZENOH_PICO_LIB)
zephyr_include_directories(../../lib/zenoh-pico/include)
add_definitions(-DZENOH_ZEPHYR=1)
endif()

FILE(GLOB app_sources
    PRIVATE
    src/*.c
)

target_sources(app PRIVATE ${app_sources})
```

## Kconfig
```
# Copyright (c) 2021 Nordic Semiconductor ASA
# SPDX-License-Identifier: Apache-2.0
#
# This file is the application Kconfig entry point. All application Kconfig
# options can be defined here or included via other application Kconfig files.
# You can browse these options using the west targets menuconfig (terminal) or
# guiconfig (GUI).

menu "Zephyr"
source "Kconfig.zephyr"
endmenu

module = ZENOH_SESSION_RESTART
module-str = ZENOH_SESSION_RESTART
source "subsys/logging/Kconfig.template.log_config"
```

## prj.conf
```kconfig
# User defined libraries
CONFIG_ZENOH_PICO_LIB=y

# Thread analyzer used for knowing cpu usage
CONFIG_THREAD_ANALYZER=y
CONFIG_THREAD_ANALYZER_USE_PRINTK=n
CONFIG_THREAD_ANALYZER_ISR_STACK_USAGE=n

# Needed to have the chip's serial number
CONFIG_HWINFO=y

# zperf is the zephyr equivalent to iperf
# CONFIG_NET_ZPERF=y

# C++ support
CONFIG_CPP=y
CONFIG_CPP_MAIN=y
CONFIG_GLIBCXX_LIBCPP=y
CONFIG_STD_CPP20=y

# Important for thread debugging info by doing:
#       info threads
# To switch threads:
#       thread <thread ID>
CONFIG_DEBUG_THREAD_INFO=y

# Kernel options
CONFIG_MAIN_STACK_SIZE=5120
# This value can be played with. This is the memory pool used by Zenoh for its dynamic allocations.
# As far as I know it just needs to be bigger than zenoh-pico's Z_BATCH_SIZE_RX and Z_BATCH_SIZE_TX.
# Directions on how to properly set Z_BATCH_SIZE_RX and Z_BATCH_SIZE_TX can be found here:
# https://github.com/eclipse-zenoh/zenoh-pico/issues/151#issuecomment-1410893732
CONFIG_HEAP_MEM_POOL_SIZE=20480
CONFIG_SYS_HEAP_RUNTIME_STATS=y
CONFIG_SYS_MEM_BLOCKS=y
CONFIG_SYS_MEM_BLOCKS_RUNTIME_STATS=y
CONFIG_ENTROPY_GENERATOR=y
CONFIG_TEST_RANDOM_GENERATOR=y
CONFIG_INIT_STACKS=y

# Generic library options
CONFIG_NEWLIB_LIBC=y
CONFIG_NEWLIB_LIBC_NANO=n
CONFIG_POSIX_API=y

# Generic networking options
CONFIG_SERIAL=y
CONFIG_NETWORKING=y

CONFIG_NET_L2_ETHERNET=y
CONFIG_NET_L2_ETHERNET_MGMT=y

CONFIG_NET_IPV4=y
CONFIG_NET_IPV6=y
CONFIG_NET_TCP=y
CONFIG_NET_ARP=y
CONFIG_NET_UDP=y
CONFIG_NET_DHCPV4=n
CONFIG_NET_SHELL=y
CONFIG_NET_MGMT=y
CONFIG_NET_MGMT_EVENT=y
CONFIG_DNS_RESOLVER=y

# Sockets
CONFIG_NET_SOCKETS=y
CONFIG_NET_SOCKETS_POLL_MAX=4

# Network driver config
CONFIG_TEST_RANDOM_GENERATOR=y
CONFIG_INIT_STACKS=y

# Network buffers
CONFIG_NET_PKT_RX_COUNT=16
CONFIG_NET_PKT_TX_COUNT=16
CONFIG_NET_BUF_RX_COUNT=80
CONFIG_NET_BUF_TX_COUNT=80
CONFIG_NET_CONTEXT_NET_PKT_POOL=y

# Network address config
CONFIG_NET_CONFIG_SETTINGS=y
CONFIG_NET_IPV4_IGMP=y
CONFIG_NET_CONFIG_NEED_IPV6=y
CONFIG_NET_IPV6_MLD=y
CONFIG_NET_CONFIG_MY_IPV4_ADDR="192.0.2.4"
CONFIG_NET_CONFIG_MY_IPV6_ADDR="2001:db8::2"
CONFIG_NET_CONFIG_PEER_IPV6_ADDR="2001:db8::1"

# IP address options
CONFIG_NET_IF_UNICAST_IPV6_ADDR_COUNT=3
CONFIG_NET_IF_MCAST_IPV6_ADDR_COUNT=4
CONFIG_NET_MAX_CONTEXTS=10

# Logging
CONFIG_NET_LOG=y
CONFIG_LOG=y
CONFIG_NET_STATISTICS=y
CONFIG_PRINTK=y
```

## boards/nucleo_f439zi.conf
```kconfig
CONFIG_ETH_STM32_HAL_API_V2=y
CONFIG_ETH_STM32_HW_CHECKSUM=y
```

## src/main.c
```c
//
// Copyright (c) 2022 ZettaScale Technology
//
// This program and the accompanying materials are made available under the
// terms of the Eclipse Public License 2.0 which is available at
// http://www.eclipse.org/legal/epl-2.0, or the Apache License, Version 2.0
// which is available at https://www.apache.org/licenses/LICENSE-2.0.
//
// SPDX-License-Identifier: EPL-2.0 OR Apache-2.0
//
// Contributors:
//   ZettaScale Zenoh Team, <zenoh@zettascale.tech>

#include <stdio.h>
#include <stdlib.h>
#include <string.h>
#include <unistd.h>
#include <zenoh-pico.h>

#define CLIENT_OR_PEER 0  // 0: Client mode; 1: Peer mode
#if CLIENT_OR_PEER == 0
#define MODE "client"
#define PEER ""  // If empty, it will scout
#elif CLIENT_OR_PEER == 1
#define MODE "peer"
#define PEER "udp/224.0.0.225:7447#iface=en0"
#else
#error "Unknown Zenoh operation mode. Check CLIENT_OR_PEER value."
#endif

#define KEYEXPR "demo/example/zenoh-pico-pub"
#define VALUE "[STSTM32]{nucleo-F767ZI} Pub from Zenoh-Pico!"


#include <zephyr/sys/sys_heap.h>
extern struct sys_heap _system_heap;

void print_sys_heap()
{
    int err;
    struct sys_memory_stats stats;

    err = sys_heap_runtime_stats_get(&_system_heap, &stats);
    if (err) {
        printf("Failed to read kernel system heap statistics (err %d)\n", err);
    }

    printf("free:           %zu\t", stats.free_bytes);
    printf("allocated:      %zu\t", stats.allocated_bytes);
    printf("max. allocated: %zu\n", stats.max_allocated_bytes);
}

int main(int argc, char **argv) {

    // print_sys_heap();
    // const int array_size = 700;
    // int* ptr_array[array_size];
    // for (int i = 0; i < array_size; i++)
    // {
    //     ptr_array[i] = (int*)k_malloc(sizeof(int));
    // }
    // //print_sys_heap();

    // for (int i = 0; i < array_size; i++)
    // {
    //     k_free(ptr_array[i]);
    //     ptr_array[i] = NULL;
    // }

    // sys_heap_print_info(&_system_heap, false);

    while (true) {
        sleep(5);

        // print_sys_heap();
        // sys_heap_print_info(&_system_heap, false);

        // Initialize Zenoh Session and other parameters
        z_owned_config_t config = z_config_default();
        zp_config_insert(z_loan(config), Z_CONFIG_MODE_KEY, z_string_make(MODE));
        if (strcmp(PEER, "") != 0) {
            zp_config_insert(z_loan(config), Z_CONFIG_PEER_KEY, z_string_make(PEER));
        }

        // Open Zenoh session
        printf("Opening Zenoh Session...");
        z_owned_session_t s = z_open(z_move(config));
        if (!z_check(s)) {
            printf("Unable to open session!\n");
            exit(-1);
        }
        printf("OK\n");
        //print_sys_heap();
        // sys_heap_print_info(&_system_heap, false);
        bool session_is_valid = true;

        printf("Starting tasks...");
        // Start the receive and the session lease loop for zenoh-pico
        zp_start_read_task(z_loan(s), NULL);
        zp_start_lease_task(z_loan(s), NULL);
        printf("OK\n");

        // print_sys_heap();
        // sys_heap_print_info(&_system_heap, false);

        printf("Declaring publisher for '%s'...", KEYEXPR);
        z_owned_publisher_t pub = z_declare_publisher(z_loan(s), z_keyexpr(KEYEXPR), NULL);
        if (!z_check(pub)) {
            printf("Unable to declare publisher for key expression!\n");
            exit(-1);
        }
        printf("OK\n");

        char buf[256];
        for (int idx = 0; session_is_valid; ++idx) {
            sleep(1);
            sprintf(buf, "[%4d] %s", idx, VALUE);
            printf("Putting Data ('%s': '%s')...\n", KEYEXPR, buf);
            int put_res = z_publisher_put(z_loan(pub), (const uint8_t *)buf, strlen(buf), NULL);
            if (put_res != _Z_RES_OK) {
                printf("Error publishing message (%d)\n", put_res);
                session_is_valid = false;
            }
            if(!z_check(s)) {
                printf("Zenoh session has become invalid\n");
            }
        }

        z_undeclare_publisher(z_move(pub));

        printf("Stopping tasks...");
        // Stop the receive and the session lease loop for zenoh-pico
        zp_stop_read_task(z_loan(s));
        zp_stop_lease_task(z_loan(s));
        printf("OK\n");

        //print_sys_heap();
        // sys_heap_print_info(&_system_heap, false);

        printf("Closing Zenoh Session...");
        z_close(z_move(s));
        printf("OK!\n");

        //print_sys_heap();
        sys_heap_print_info(&_system_heap, false);

    }

    return 0;
}
```
