## boards/arm/nucleo_f439zi/Kconfig.board
```kconfig
# NUCLEO-144 F439ZI  board configuration

# Copyright (c) 2017 Linaro Limited
# SPDX-License-Identifier: Apache-2.0

config BOARD_NUCLEO_F439ZI
	bool "NUCLEO-144 F439ZI Development Board"
	depends on SOC_STM32F429XX
```

## boards/arm/nucleo_f439zi/Kconfig.defconfig
```kconfig
# NUCLEO-144 F429ZI 2 board configuration

if BOARD_NUCLEO_F429ZI_2

config BOARD
	default "nucleo_f429zi_2"

if NETWORKING

config NET_L2_ETHERNET
	default y

endif # NETWORKING

endif # BOARD_NUCLEO_F429ZI_2
```

## lib/Kconfig
```kconfig
# Copyright (c) 2021 Legrand North America, LLC.
# SPDX-License-Identifier: Apache-2.0

menu "Libraries"

# TODO: This is not ideal. We'd prefer to have a Kconfig and a CMakeLists.txt in Zenoh-Pico. That
# way integrates better with the Zephyr library scheme. But that'll do for now.
config ZENOH_PICO_LIB
	bool "Zenoh-Pico Library"
	help
	  This option enables the custom_lib library


endmenu
```

## west.yml
```yaml
# Copyright (c) 2021 Nordic Semiconductor ASA
# SPDX-License-Identifier: Apache-2.0

# More info about west manifests: https://docs.zephyrproject.org/latest/develop/west/manifest.html
manifest:
  self:
    west-commands: scripts/west-commands.yml

  remotes:
    - name: zephyrproject-rtos
      url-base: https://github.com/zephyrproject-rtos

  projects:
    - name: zephyr
      remote: zephyrproject-rtos
      # revision: v3.3.0
      revision: v3.4.0
      import:
        # That puts all the zephyr dependencies in ../zephyr-external
        path-prefix: zephyr-external
        # By using name-allowlist we can clone only the modules that are
        # strictly needed by the application.
        name-allowlist:
          - cmsis      # required by the ARM port
          - hal_stm32  # required by the nucleo boards (STM32 based)
          - mbedtls
          # TODO: It would be better to have zenoh-pico here
```
